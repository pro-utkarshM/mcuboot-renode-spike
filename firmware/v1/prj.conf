## CMakeLists.txt
```
# SPDX-License-Identifier: Apache-2.0

cmake_minimum_required(VERSION 3.20.0)
find_package(Zephyr REQUIRED HINTS $ENV{ZEPHYR_BASE})
project(ota_spike_v1)

target_sources(app PRIVATE src/main.c)
```

## sysbuild.conf
```
# Build MCUboot as a sysbuild image using the mode supported by the upstream
# nRF52840 DK two-slot partition layout.
SB_CONFIG_BOOTLOADER_MCUBOOT=y
SB_CONFIG_MCUBOOT_MODE_SWAP_USING_OFFSET=y
SB_CONFIG_BOOT_SIGNATURE_KEY_FILE="/workspace/app/keys/root-rsa-2048.pem"
```

## prj.conf
```kconfig
# This application is always built by sysbuild together with MCUboot.
CONFIG_BOOTLOADER_MCUBOOT=y
CONFIG_MCUBOOT_SIGNATURE_KEY_FILE="/workspace/app/keys/root-rsa-2048.pem"
CONFIG_MCUBOOT_IMGTOOL_SIGN_VERSION="1.0.0+0"
CONFIG_BUILD_OUTPUT_BIN=y

# UART0 is the upstream nrf52840dk console and zephyr,uart-mcumgr device.
CONFIG_SERIAL=y
CONFIG_CONSOLE=y
CONFIG_UART_CONSOLE=y
CONFIG_UART_INTERRUPT_DRIVEN=y

# Framed SMP (MCUmgr) over the console UART.  UART_MCUMGR is an explicit
# dependency of MCUMGR_TRANSPORT_UART in Zephyr 4.4.
CONFIG_BASE64=y
CONFIG_CRC=y
CONFIG_NET_BUF=y
CONFIG_ZCBOR=y
CONFIG_MCUMGR=y
CONFIG_UART_MCUMGR=y
CONFIG_MCUMGR_TRANSPORT_UART=y
CONFIG_MCUMGR_TRANSPORT_UART_MTU=256
CONFIG_MCUMGR_TRANSPORT_NETBUF_SIZE=512
CONFIG_MCUMGR_GRP_IMG=y
CONFIG_MCUMGR_GRP_OS=y
CONFIG_MCUMGR_GRP_OS_INFO=n
CONFIG_MCUMGR_GRP_OS_ECHO=n
CONFIG_IMG_MANAGER=y
CONFIG_STREAM_FLASH=y

# The spike uses no LEDs, buttons, or GPIO API. UART pin routing is handled by
# Nordic pinctrl, so excluding the board's unused GPIO stack reduces every
# signed image and therefore the real word-program cut-point count.
CONFIG_GPIO=n

# The upstream board's storage_partition is 32 KiB (eight 4 KiB sectors).
CONFIG_FLASH=y
CONFIG_FLASH_MAP=y
CONFIG_NVS=y
CONFIG_SETTINGS=y
CONFIG_SETTINGS_NVS=y
CONFIG_SETTINGS_NVS_SECTOR_COUNT=8

CONFIG_MAIN_STACK_SIZE=3072
CONFIG_SYSTEM_WORKQUEUE_STACK_SIZE=2304
```

## src/main.c
```c
/*
 * SPDX-License-Identifier: Apache-2.0
 *
 * Immutable deployed image for the MCUboot/MCUmgr power-loss spike.
 */

#include <errno.h>
#include <stdbool.h>
#include <stdint.h>
#include <string.h>

#include <zephyr/kernel.h>
#include <zephyr/settings/settings.h>
#include <zephyr/sys/printk.h>

#define SPIKE_STATE_MAGIC 0x5350494bU /* "SPIK" */
#define SPIKE_STATE_SCHEMA 1U

struct spike_persistent_state {
	uint32_t magic;
	uint16_t schema;
	uint16_t reserved;
	uint32_t generation;
};

static struct spike_persistent_state persistent_state;
static bool persistent_state_loaded;
static volatile uint32_t ram_boot_marker;

static int spike_settings_set(const char *name, size_t len_rd,
			      settings_read_cb read_cb, void *cb_arg)
{
	ssize_t read_len;

	/* v1 must tolerate v2's forward-compatible settings after a revert. */
	if (strcmp(name, "state") != 0) {
		return 0;
	}
	if (len_rd != sizeof(persistent_state)) {
		return -EINVAL;
	}

	read_len = read_cb(cb_arg, &persistent_state, sizeof(persistent_state));
	if (read_len != sizeof(persistent_state) ||
	    persistent_state.magic != SPIKE_STATE_MAGIC ||
	    persistent_state.schema != SPIKE_STATE_SCHEMA) {
		return -EINVAL;
	}

	persistent_state_loaded = true;
	return 0;
}

SETTINGS_STATIC_HANDLER_DEFINE(ota_spike, "spike", NULL, spike_settings_set,
			       NULL, NULL);

int main(void)
{
	int rc;

	/* A machine reset clears .bss, so every fresh boot must report one. */
	ram_boot_marker++;
	printk("FIRMWARE_VERSION=1.0.0\n");
	printk("RAM_BOOT_MARKER_RESET=%u\n", ram_boot_marker);

	rc = settings_subsys_init();
	if (rc != 0) {
		printk("PERSISTENT_SETTING=error:init:%d\n", rc);
		return rc;
	}

	rc = settings_load();
	if (rc != 0) {
		printk("PERSISTENT_SETTING=error:load:%d\n", rc);
		return rc;
	}

	if (!persistent_state_loaded) {
		persistent_state = (struct spike_persistent_state){
			.magic = SPIKE_STATE_MAGIC,
			.schema = SPIKE_STATE_SCHEMA,
			.generation = 1U,
		};
		rc = settings_save_one("spike/state", &persistent_state,
				       sizeof(persistent_state));
		if (rc != 0) {
			printk("PERSISTENT_SETTING=error:save:%d\n", rc);
			return rc;
		}
		printk("PERSISTENT_SETTING=initialized:generation=1\n");
	} else {
		printk("PERSISTENT_SETTING=loaded:generation=%u\n",
		       persistent_state.generation);
	}

	return 0;
}
```
